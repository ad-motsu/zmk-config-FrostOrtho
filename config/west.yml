## config/west.yml
```yaml
manifest:
  remotes:
    - name: zmkfirmware
      url-base: https://github.com/zmkfirmware
    - name: caksoylar
      url-base: https://github.com/caksoylar
    - name: sekigon-gonnoc  # PAW3222
      url-base: https://github.com/sekigon-gonnoc
    - name: cormoran
      url-base: https://github.com/cormoran
    - name: imo00o
      url-base: https://github.com/imo00o
    - name: kot149  # マウスジェスチャー
      url-base: https://github.com/kot149
    - name: te9no
      url-base: https://github.com/te9no
  projects:
    - name: zmk
      remote: cormoran
      revision: e5c9b6915b56801193e359dd9bad4a167ce0d1b8
      import: app/west.yml
    - name: zmk-driver-paw3222
      remote: sekigon-gonnoc
      revision: df652881be2520bde4f64ab6ca35e4c5708f4f9b
    - name: zmk-mouse-gesture
      remote: kot149
      revision: 66f905e43cb5d36ef397b26c69c36e7da71dc585
    - name: zmk-rgbled-widget
      remote: caksoylar
      revision: e6b467792a1dabef8cfa5c9fd26bfefc9c16662b
    # DYA Studio モジュール
    - name: zmk-module-ble-management
      remote: cormoran
      revision: 57738cc4fc6ba80e82a7ac57741a0339cb186cd4
    - name: zmk-module-battery-history
      remote: cormoran
      revision: 307755dd2ad4d320e14de162e8e5ef018f29d929
    - name: zmk-module-settings-rpc
      remote: cormoran
      revision: 083a299dd8d31c275809c5a249b12486be24a7d2
    - name: zmk-module-runtime-input-processor
      remote: te9no
      revision: 72387b5212264d26d704dbc43c765f6485470a77
    - name: zmk-behavior-runtime-sensor-rotate
      remote: cormoran
      revision: 8b1125ed676c1f5e14145d217984f33d0ebdcef4
    - name: zmk-feature-runtime-combo
      remote: cormoran
      revision: d9490e7b5d41c516221d131241009e81740efcee
      import:
        name-blocklist:
          - zmk-feature-custom-settings
    - name: zmk-feature-runtime-macro
      remote: cormoran
      revision: 38530962eb7061b60efcb98e84585cfb1f0cb6de
      import:
        name-blocklist:
          - zmk-feature-custom-settings
    - name: zmk-feature-custom-settings
      remote: cormoran
      revision: c6a7fef3a3be3d3ace5de9a4b0628c6418cd1f3f
      path: zmk-feature-custom-settings
  self:
    path: config
```
